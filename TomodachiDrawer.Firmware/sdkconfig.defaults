## TomodachiDrawer.Firmware/sdkconfig.defaults
```kconfig
CONFIG_IDF_TARGET="esp32c3"

CONFIG_TINYUSB_ENABLED=y
CONFIG_TINYUSB_HID_ENABLED=y
CONFIG_TINYUSB_HID_BUFSIZE=64
CONFIG_TINYUSB_DESC_USE_ESPRESSIF_VID=n
CONFIG_TINYUSB_DP_PIN=19
CONFIG_TINYUSB_DM_PIN=18

CONFIG_TINYUSB_CDC_ENABLED=n
CONFIG_ESP_CONSOLE_NONE=y

CONFIG_RMT_SUPPRESS_DEPRECATE_WARN=y
```
